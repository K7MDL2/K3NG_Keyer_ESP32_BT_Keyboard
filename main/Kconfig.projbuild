## main/Kconfig.projbuild
```kconfig
# Kconfig.projbuild for main component
# No custom Kconfig for main in this example, but file is needed
# - if main has dependencies that need configuration processing.
# Kconfig.projbuild for component 'custom_module'

menu "LCD_Display_Device"
        
    choice Select_LCD_Display_Module
        prompt "Select LCD Display"
        default TEXT_I2C_4x20_LCD
        help
            Driver for the TFT LCD screen

        config TEXT_I2C_4x20_LCD
            bool "Classic 4 Line x 20 Character Display using I2C"
            help
                Loads correct components 

        config TFT_1_9_IDEASPARK_LCD
            bool "IdeaSpark ESP32 with 1.9 Color TFT LCD" 
            help
                Loads correct compnents

        config TFT_3_2_DIYMALLS_LCD
            bool "DIYMALLS ESP32 with 3.2 inch Color TFT LCD"
            help
                Loads correct components

        config M5STACK_CORE2_LCD
            bool "M5Stack Core2 Module with 2 inch color TFT LCD"
            help
                Loads correct components

        config NO_DISPLAY
            bool "No display"
            help
                Will not load display related code
    endchoice

        config DISPLAY_TYPE_NAME
            int
            default 0 if NO_DISPLAY
            default 1 if TEXT_I2C_4x20_LCD
            default 2 if TFT_1_9_IDEASPARK_LCD
            default 3 if TFT_3_2_DIYMALLS_LCD
            default 4 if M5STACK_CORE2_LCD

endmenu   
```

## sdkconfig.defaults
```kconfig
CONFIG_PARTITION_TABLE_CUSTOM=y
CONFIG_PARTITION_TABLE_CUSTOM_FILENAME="partitions.csv"
CONFIG_PARTITION_TABLE_FILENAME="partitions.csv"
CONFIG_PARTITION_TABLE_OFFSET=0x9000
CONFIG_PARTITION_TABLE_MD5=y
CONFIG_ARDUINO_VARIANT="esp32"
CONFIG_ENABLE_ARDUINO_DEPENDS=y
CONFIG_ARDUHAL_PARTITION_SCHEME_HUGE_APP=y
CONFIG_ARDUHAL_PARTITION_SCHEME="huge_app"
CONFIG_BT_ENABLED=y
CONFIG_BTDM_CTRL_MODE_BTDM=y
CONFIG_BT_BLUEDROID_ENABLED=y
# CONFIG_BT_NIMBLE_ENABLED is not set
# CONFIG_BT_CONTROLLER_ONLY is not set
CONFIG_BT_CONTROLLER_ENABLED=y
# CONFIG_BT_CONTROLLER_DISABLED is not set
CONFIG_BT_CLASSIC_ENABLED=y
CONFIG_BT_HID_ENABLED=y
CONFIG_BT_HID_HOST_ENABLED=y
CONFIG_BT_BLE_ENABLED=y
CONFIG_BT_GATTS_ENABLE=y
CONFIG_BT_GATTC_CONN_MAX=64
CONFIG_BT_GATTC_MAX_CACHE_CHAR=64
CONFIG_BT_GATTC_NOTIF_REG_MAX=64
CONFIG_BT_GATTC_CACHE_NVS_FLASH=y
CONFIG_BT_BLE_SMP_BOND_NVS_FLASH=y
CONFIG_BT_STACK_NO_LOG=y
CONFIG_BT_MULTI_CONNECTION_ENBALE=y
CONFIG_BT_BLE_42_FEATURES_SUPPORTED=y
CONFIG_FREERTOS_HZ=1000
CONFIG_LOG_MAXIMUM_LEVEL=0
CONFIG_DIAG_USE_EXTERNAL_LOG_WRAP=y
CONFIG_ARDUHAL_ESP_LOG=y
CONFIG_GATTS_ENABLE=y
CONFIG_GATTC_CACHE_NVS_FLASH=y
CONFIG_BTDM_CONTROLLER_MODE_BTDM=y
CONFIG_BTDM_CONTROLLER_BLE_MAX_CONN=3
CONFIG_BTDM_CONTROLLER_HCI_MODE_VHCI=y
CONFIG_ESP_INT_WDT_TIMEOUT_MS=1200
CONFIG_ESP_WIFI_ENABLED=n
CONFIG_COMPILER_CXX_EXCEPTIONS=y
CONFIG_APP_BUILD_TYPE_PURE_RAM_APP=n 
# CONFIG_ESP_DEFAULT_CPU_FREQ_MHZ_80 is not set
# CONFIG_ESP_DEFAULT_CPU_FREQ_MHZ_160 is not set
CONFIG_ESP_DEFAULT_CPU_FREQ_MHZ_240=y
CONFIG_ESP_DEFAULT_CPU_FREQ_MHZ=240
CONFIG_ESPTOOLPY_FLASHMODE_QIO=y
# CONFIG_ESPTOOLPY_FLASHMODE_QOUT is not set
# CONFIG_ESPTOOLPY_FLASHMODE_DIO is not set
# CONFIG_ESPTOOLPY_FLASHMODE_DOUT is not set
CONFIG_ESPTOOLPY_FLASH_SAMPLE_MODE_STR=y
CONFIG_ESPTOOLPY_FLASHMODE="qio"
CONFIG_ESPTOOLPY_FLASHFREQ_80M=y
# CONFIG_ESPTOOLPY_FLASHFREQ_40M is not set
CONFIG_I2CDEV_DEFAULT_SDA_PIN=21
CONFIG_I2CDEV_DEFAULT_SCL_PIN=22
CONFIG_I2CDEV_MAX_DEVICES_PER_PORT=8
CONFIG_I2CDEV_TIMEOUT=1000
```
